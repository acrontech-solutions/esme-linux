## conf/layer.conf
```bitbake
# We have a conf and classes directory, add to BBPATH
BBPATH .= ":${LAYERDIR}"

# We have recipes-* directories, add to BBFILES
BBFILES += "${LAYERDIR}/recipes-*/*/*.bb \
            ${LAYERDIR}/recipes-*/*/*.bbappend"

BBFILE_COLLECTIONS += "meta-acrontech"
BBFILE_PATTERN_meta-acrontech = "^${LAYERDIR}/"
BBFILE_PRIORITY_meta-acrontech = "6"

LAYERDEPENDS_meta-acrontech = "core"
LAYERSERIES_COMPAT_meta-acrontech = "scarthgap"
```
